## CMakeLists.txt
```
# SPDX-License-Identifier: Apache-2.0

cmake_minimum_required(VERSION 3.20.0)

set(ZEPHYR_EXTRA_MODULES "${CMAKE_CURRENT_SOURCE_DIR}/../lua_module/")

find_package(Zephyr REQUIRED HINTS $ENV{ZEPHYR_BASE})
project(hello_lua)

include_directories(include/)

add_lua_thread("src/producer.lua")

file(GLOB_RECURSE SRC ${CMAKE_SOURCE_DIR} "src/*.c")

target_sources(app PRIVATE ${SRC})
```

## Kconfig
```
menu "Zephyr"
source "Kconfig.zephyr"
endmenu

module = APP
module-str = APP

menu "Artemis"
  menu "Lua"
    config LUA_HEAP_SIZE_KB
      int "Size of the heap used by the Lua allocator, in KB"
      default 32
  endmenu
endmenu

menu "Fence"
  menu "test"
    config TEST_FENCE
      bool "Enable fence test"
      default n  
  endmenu
endmenu

menu "Threads"
  menu "Hook"
    config THREAD_HOOK_STACK_SIZE
      int "The stack size of the Hook event dispatcher, in bytes"
      default 2048
  endmenu
endmenu
```

## prj.conf
```kconfig
CONFIG_BOOT_BANNER=n
CONFIG_QEMU_ICOUNT=n
CONFIG_LOG=y

CONFIG_SHELL=y
# CONFIG_THREAD_STATISTICS=y

CONFIG_ASSERT=y
CONFIG_MAIN_STACK_SIZE=2048

CONFIG_ZBUS=y
CONFIG_ZBUS_CHANNEL_NAME=y
CONFIG_ZBUS_MSG_SUBSCRIBER=y

CONFIG_NEWLIB_LIBC=y

CONFIG_SYS_HEAP_RUNTIME_STATS=y
CONFIG_SYS_HEAP_ARRAY_SIZE=1
```

## src/main.c
```c
#include <zephyr/kernel.h>
#include <zephyr/zbus/zbus.h>

struct msg_input {
	int data;
};

ZBUS_CHAN_DEFINE(chan_random_input, struct msg_input, NULL, NULL, ZBUS_OBSERVERS(msub_consumer),
		 ZBUS_MSG_INIT(.data = 0));

ZBUS_MSG_SUBSCRIBER_DEFINE(msub_consumer);

int main(int argc, char *argv[])
{
	const struct zbus_channel *chan;
	struct msg_input msg;

	while (1) {
		zbus_sub_wait_msg(&msub_consumer, &chan, &msg, K_FOREVER);

		printk("Random data %d\n", msg.data);
	}
	return 0;
}
```

## src/zbus_lua_wrappers.c
```c
#include <lauxlib.h>
#include <lualib.h>
#include <sys/times.h>
#include <time.h>
#include <zephyr/zbus/zbus.h>

ZBUS_CHAN_DECLARE(chan_random_input);

static int chan_random_input_pub(lua_State *L)
{
	int n = lua_gettop(L);
	if (n != 2) {
		return luaL_error(L, "expected 1 arguments, got %d", n);
	}

	struct {
		int data;
	} msg = {.data = (int)luaL_checknumber(L, 1)};

	int err = zbus_chan_pub(&chan_random_input, &msg, K_MSEC(luaL_checkinteger(L, 2)));

	lua_pushinteger(L, err);

	return 1;
}

static const luaL_Reg c_wrappers[] = {
	{"pub_random_input", chan_random_input_pub},
	{NULL, NULL} // Sentinel value to mark the end of the array
};

static int luaopen_zbus(lua_State *L)
{
	luaL_newlib(L, c_wrappers);
	return 1;
}

int lua_register_chan_random_input(lua_State *L)
{
	luaL_requiref(L, "zbus_wrappers", luaopen_zbus, 1);
	lua_pop(L, 1);

	return 0;
}

int lua_producer_setup(lua_State *L)
{
	lua_register_chan_random_input(L);

	return 0;
}
```
