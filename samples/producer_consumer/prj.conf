## CMakeLists.txt
```
# SPDX-License-Identifier: Apache-2.0

cmake_minimum_required(VERSION 3.20.0)

set(ZEPHYR_EXTRA_MODULES "${CMAKE_CURRENT_SOURCE_DIR}/../../lua_zephyr/")

find_package(Zephyr REQUIRED HINTS $ENV{ZEPHYR_BASE})
project(producer_consumer)

list(APPEND CMAKE_MODULE_PATH ${ZEPHYR_BASE}/modules/nanopb)
include(nanopb)

set(NANOPB_OPTIONS "--c-style")
zephyr_nanopb_sources(app proto/channels.proto)

include_directories(include/)

add_lua_thread("src/producer.lua")

file(GLOB_RECURSE SRC ${CMAKE_SOURCE_DIR} "src/*.c")

target_sources(app PRIVATE ${SRC})
```

## sample.yaml
```
sample:
  name: Producer consumer
tests:
  sample.lua_zephyr.producer_consumer:
    harness: console
    extra_configs:
      - platform:mps2/an385:CONFIG_QEMU_ICOUNT=y
      - platform:qemu_x86:CONFIG_QEMU_ICOUNT=y
      - CONFIG_SHELL=n
    harness_config:
      type: multi_line
      ordered: true
      regex:
        - "System version: v\\d+\\.\\d+\\.\\d+_\\w+"
        - "Sensor_config=\\{sensor_id=42 offset=\\{x=1, y=2, z=3\\}\\}"
        - "<-- Lua producing data"
        - "\\s*1 - Accelerometer data x=\\d\\d,y=\\d\\d,z=\\d\\d"
        - "--> Lua received ack 1"
        - "\\s*2 - Accelerometer data x=\\d\\d,y=\\d\\d,z=\\d\\d"
        - "--> Lua received ack 2"
        - "\\s*3 - Accelerometer data x=\\d\\d,y=\\d\\d,z=\\d\\d"
        - "--> Lua received ack 3"
        - "\\s*4 - Accelerometer data x=\\d\\d,y=\\d\\d,z=\\d\\d"
        - "--> Lua received ack 4"
        - "\\s*5 - Accelerometer data x=\\d\\d,y=\\d\\d,z=\\d\\d"
        - "--> Lua received ack 5"
        - "\\s*6 - Accelerometer data x=\\d\\d,y=\\d\\d,z=\\d\\d"
        - "--> Lua received ack 6"
        - "\\s*7 - Accelerometer data x=\\d\\d,y=\\d\\d,z=\\d\\d"
        - "--> Lua received ack 7"
        - "\\s*8 - Accelerometer data x=\\d\\d,y=\\d\\d,z=\\d\\d"
        - "--> Lua received ack 8"
        - "\\s*9 - Accelerometer data x=\\d\\d,y=\\d\\d,z=\\d\\d"
        - "--> Lua received ack 9"
        - "\\s*10 - Accelerometer data x=\\d\\d,y=\\d\\d,z=\\d\\d"
        - "--> Lua received ack 10"
        - "heap:\\s+\\d+\\s+\\d+\\s+\\d+\\s+\\d+%"
        - "stack:\\s+\\d+\\s+\\d+\\s+\\d+\\s+\\d+%"
    tags: lua_zephyr
    integration_platforms:
      - qemu_x86
      - mps2/an385
```

## prj.conf
```kconfig
CONFIG_LUA=y
CONFIG_LUA_PRECOMPILE=y
CONFIG_LUA_PRECOMPILE_ONLY=y
CONFIG_NANOPB=y

CONFIG_BOOT_BANNER=n
CONFIG_QEMU_ICOUNT=n
CONFIG_LOG=y
CONFIG_LOG_MODE_MINIMAL=y
CONFIG_LUA_ZEPHYR_LOG_LEVEL_DBG=y
# CONFIG_THREAD_STATISTICS=y

CONFIG_ASSERT=y

CONFIG_ZBUS=y
CONFIG_ZBUS_CHANNEL_NAME=y
CONFIG_ZBUS_MSG_SUBSCRIBER=y

CONFIG_NEWLIB_LIBC=y

CONFIG_SYS_HEAP_RUNTIME_STATS=y
CONFIG_SYS_HEAP_ARRAY_SIZE=1
```

## src/main.c
```c
#include <zephyr/kernel.h>
#include <zephyr/zbus/zbus.h>

struct msg_input {
	int data;
};

ZBUS_CHAN_DEFINE(chan_random_input, struct msg_input, NULL, NULL, ZBUS_OBSERVERS(msub_consumer),
		 ZBUS_MSG_INIT(.data = 0));

ZBUS_MSG_SUBSCRIBER_DEFINE(msub_consumer);

int main(int argc, char *argv[])
{
	const struct zbus_channel *chan;
	struct msg_input msg;
	int count = 0;

	while (1) {
		zbus_sub_wait_msg(&msub_consumer, &chan, &msg, K_FOREVER);

		printk(" %d - Random data %d\n", count, msg.data);

		++count;
	}
	return 0;
}
```

## include/channels.h
```c
#ifndef CONSUMER_H
#define CONSUMER_H

#include <lualib.h>
#include <zephyr/zbus/zbus.h>

struct msg_acc_data {
	int x;
	int y;
	int z;
};
ZBUS_CHAN_DECLARE(chan_acc_data); /* Type: struct msg_acc_data */

struct msg_acc_data_consumed {
	int count;
};
ZBUS_CHAN_DECLARE(chan_acc_data_consumed); /* Type: struct msg_acc_data_consumed */

struct msg_version {
	uint8_t major;
	uint8_t minor;
	uint8_t patch;
	const char *hardware_id;
};
ZBUS_CHAN_DECLARE(chan_version); /* Type: struct msg_version */

struct msg_sensor_config {
	int sensor_id;
	struct msg_acc_data offset;
};
ZBUS_CHAN_DECLARE(chan_sensor_config); /* Type: struct msg_sensor_config */

#endif /* !CONSUMER_H */
```

## src/channels.c
```c
/**
 * @file channels.c
 * @brief Producer-consumer sample: zbus channel definitions with nanopb descriptors.
 *
 * Defines all zbus channels used by the sample.  Each channel's user_data
 * is populated with an auto-generated lua_msg_descr via LUA_PB_DESCR_DEFINE,
 * enabling automatic Lua table <-> C struct conversion.
 */

#include "channels.h"
#include <lua_zephyr/lua_msg_descr_pb.h>

/* clang-format off */
LUA_PB_DESCR_DEFINE(msg_acc_data);
ZBUS_CHAN_DEFINE(chan_acc_data, struct msg_acc_data, NULL,
		LUA_PB_DESCR_REF(msg_acc_data),
		ZBUS_OBSERVERS_EMPTY,
		ZBUS_MSG_INIT(.x = 0, .y = 0, .z = 0));

LUA_PB_DESCR_DEFINE(msg_acc_data_consumed);
ZBUS_CHAN_DEFINE(chan_acc_data_consumed, struct msg_acc_data_consumed, NULL,
		LUA_PB_DESCR_REF(msg_acc_data_consumed),
		ZBUS_OBSERVERS_EMPTY,
		ZBUS_MSG_INIT(.count = 0));

LUA_PB_DESCR_DEFINE(msg_version);
ZBUS_CHAN_DEFINE(chan_version, struct msg_version, NULL,
		LUA_PB_DESCR_REF(msg_version),
		ZBUS_OBSERVERS_EMPTY,
		ZBUS_MSG_INIT(.major = 4, .minor = 7, .patch = 98, .hardware_id = "RPA9"));

LUA_PB_DESCR_DEFINE(msg_sensor_config);
ZBUS_CHAN_DEFINE(chan_sensor_config, struct msg_sensor_config, NULL,
		LUA_PB_DESCR_REF(msg_sensor_config),
		ZBUS_OBSERVERS_EMPTY,
		ZBUS_MSG_INIT(.sensor_id = 0, .offset = {0}));

/* clang-format on */
```

## src/consumer.c
```c
#include "channels.h"

ZBUS_MSG_SUBSCRIBER_DEFINE(msub_consumer);

ZBUS_CHAN_ADD_OBS(chan_acc_data, msub_consumer, 3);

void consumer_thread(void *p1, void *p2, void *p3)
{
	ARG_UNUSED(p1);
	ARG_UNUSED(p2);
	ARG_UNUSED(p3);

	const struct zbus_channel *chan;
	MsgAccData msg;
	MsgAccDataConsumed ack_msg = {.count = 0};

	while (1) {
		zbus_sub_wait_msg(&msub_consumer, &chan, &msg, K_FOREVER);
		++ack_msg.count;

		printk(" %d - Accelerometer data x=%02d,y=%02d,z=%02d\n", ack_msg.count, msg.x,
		       msg.y, msg.z);

		zbus_chan_pub(&chan_acc_data_consumed, &ack_msg, K_MSEC(250));
	}
}

K_THREAD_DEFINE(consumer_thread_id, 4096, consumer_thread, NULL, NULL, NULL, 3, 0, 0);
```

## src/producer_lua.c
```c
/**
 * @file producer_lua.c
 * @brief Producer-consumer sample: Lua-side producer setup and zbus declarations.
 *
 * Provides the _lua_setup hook for the producer Lua thread.  Loads the
 * zephyr and zbus libraries and exposes the sample channels and observers
 * to Lua.
 */

#include <lauxlib.h>
#include <lualib.h>
#include <sys/times.h>
#include <zephyr/zbus/zbus.h>
#include <luaz_utils.h>
#include <luaz_zbus.h>

#include "channels.h"

ZBUS_MSG_SUBSCRIBER_DEFINE(msub_acc_consumed);

ZBUS_CHAN_ADD_OBS(chan_acc_data_consumed, msub_acc_consumed, 3);

/** @brief Setup hook for the producer Lua thread (declares zbus channels/observers). */
int producer_lua_setup(lua_State *L)
{
	LUA_REQUIRE_ZBUS_CHAN(chan_acc_data);
	LUA_REQUIRE_ZBUS_CHAN(chan_acc_data_consumed);
	LUA_REQUIRE_ZBUS_CHAN(chan_version);
	LUA_REQUIRE_ZBUS_CHAN(chan_sensor_config);
	LUA_REQUIRE_ZBUS_OBS(msub_acc_consumed);
	return 0;
}
```

## src/zbus_lua_wrappers.c
```c
#include <lauxlib.h>
#include <lualib.h>
#include <sys/times.h>
#include <zephyr/zbus/zbus.h>
#include <lua_zephyr/utils.h>

ZBUS_CHAN_DECLARE(chan_random_input);

static int chan_random_input_pub(lua_State *L)
{
	int n = lua_gettop(L);
	if (n != 2) {
		return luaL_error(L, "expected 1 arguments, got %d", n);
	}

	struct {
		int data;
	} msg = {.data = (int)luaL_checkinteger(L, 1)};

	int err = zbus_chan_pub(&chan_random_input, &msg, K_MSEC(luaL_checkinteger(L, 2)));

	lua_pushinteger(L, err);

	return 1;
}

static const luaL_Reg c_wrappers[] = {
	{"pub_random_input", chan_random_input_pub},
	{NULL, NULL} // Sentinel value to mark the end of the array
};

static int luaopen_zbus(lua_State *L)
{
	luaL_newlib(L, c_wrappers);
	return 1;
}

int lua_producer_setup(lua_State *L)
{
	LUA_REQUIRE(zephyr);
	LUA_REQUIRE(zbus);

	return 0;
}
```
