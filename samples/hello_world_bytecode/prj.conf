## CMakeLists.txt
```
# SPDX-License-Identifier: Apache-2.0

cmake_minimum_required(VERSION 3.20.0)

set(ZEPHYR_EXTRA_MODULES "${CMAKE_CURRENT_SOURCE_DIR}/../../lua_zephyr/")

find_package(Zephyr REQUIRED HINTS $ENV{ZEPHYR_BASE})
project(hello_world_bytecode)

include_directories(include/)

add_lua_bytecode_file("src/sample01.lua")
add_lua_bytecode_thread("src/hello_world.lua")

file(GLOB_RECURSE SRC ${CMAKE_SOURCE_DIR} "src/*.c")

target_sources(app PRIVATE ${SRC})
```

## sample.yaml
```
sample:
  name: Hello World Bytecode
tests:
  sample.lua_zephyr.hello_world_bytecode:
    harness: console
    extra_configs:
      - CONFIG_QEMU_ICOUNT=y
      - CONFIG_THREAD_NAME=y
      - CONFIG_LOG_MODE_MINIMAL=y
    harness_config:
      type: multi_line
      ordered: true
      regex:
        - "-"
        - "Pre-lua vm setup for hello world lua by the user"
        - "Hello from lua thread"
        - "bye"
        - "allocated 0, free \\d+, max allocated \\d+, heap size 32768"
        - "Sample 01, finished successfully"
    tags: lua_zephyr
    integration_platforms:
      - qemu_x86
      - mps2/an385
```

## prj.conf
```kconfig
CONFIG_LUA=y
CONFIG_LUA_PRECOMPILE=y
CONFIG_LUA_PRECOMPILE_ONLY=y
CONFIG_LUA_EXTRA_OPTIMIZATIONS=y
CONFIG_LUA_ZEPHYR_LOG_LEVEL_DBG=y

CONFIG_BOOT_BANNER=n
CONFIG_QEMU_ICOUNT=n
CONFIG_LOG=y

CONFIG_ASSERT=y
CONFIG_MAIN_STACK_SIZE=4096
CONFIG_ZBUS_CHANNEL_NAME=y

CONFIG_SYS_HEAP_RUNTIME_STATS=y
CONFIG_SYS_HEAP_ARRAY_SIZE=1
```

## src/main.c
```c
/**
 * @file main.c
 * @brief Hello-world bytecode sample: runs a pre-compiled Lua script from main
 *        and a bytecode Lua thread.
 */

#include <zephyr/kernel.h>

#include <lauxlib.h>
#include <lua.h>
#include <lualib.h>
#include <luaz_utils.h>

#include "sample01_lua_bytecode.h"

/** @brief Run the sample01 Lua bytecode using the default Lua allocator. */
int main(int argc, char *argv[])
{
	lua_State *L = luaL_newstate();

	luaz_openlibs(L);

	if (luaL_loadbuffer(L, (const char *)sample01_lua_bytecode, sample01_lua_bytecode_len,
			    "sample01") != LUA_OK ||
	    lua_pcall(L, 0, LUA_MULTRET, 0) != LUA_OK) {
		printk("Error: %s\n", lua_tostring(L, -1));
		lua_pop(L, 1);
	}

	lua_close(L);

	k_sleep(K_FOREVER);
	return 0;
}
```
