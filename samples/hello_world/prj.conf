## CMakeLists.txt
```
# SPDX-License-Identifier: Apache-2.0

cmake_minimum_required(VERSION 3.20.0)

set(ZEPHYR_EXTRA_MODULES "${CMAKE_CURRENT_SOURCE_DIR}/../../")

include(${ZEPHYR_EXTRA_MODULES}/luaz.cmake)
luaz_define_source_thread(src/hello_world.lua)

find_package(Zephyr REQUIRED HINTS $ENV{ZEPHYR_BASE})
project(hello_world)

include_directories(include/)

luaz_add_file("src/sample01.lua")
luaz_generate_threads()

file(GLOB_RECURSE SRC ${CMAKE_SOURCE_DIR} "src/*.c")

target_sources(app PRIVATE ${SRC})
```

## sample.yaml
```
sample:
  name: Hello World
tests:
  sample.lua_zephyr.hello_world:
    harness: console
    extra_configs:
      - CONFIG_QEMU_ICOUNT=y
      - CONFIG_SHELL=n
      - CONFIG_THREAD_NAME=y
      - CONFIG_LOG_MODE_MINIMAL=y
    harness_config:
      type: multi_line
      ordered: true
      regex:
        - "-"
        - "Pre-lua vm setup for hello world lua by the user"
        - "Hello from lua thread"
        - "bye"
        - "allocated 0, free \\d+, max allocated \\d+, heap size 32768"
        - "Sample 01, finished successfully"
    tags: lua_zephyr
    integration_platforms:
      - qemu_x86
      - mps2/an385
```

## prj.conf
```kconfig
CONFIG_LUA=y
CONFIG_LUA_ZEPHYR_LOG_LEVEL_DBG=y
CONFIG_LUA_REPL=y

CONFIG_BOOT_BANNER=n
CONFIG_LOG=y

# CONFIG_THREAD_STATISTICS=y

CONFIG_ASSERT=y
CONFIG_MAIN_STACK_SIZE=4096

CONFIG_SYS_HEAP_RUNTIME_STATS=y
CONFIG_INIT_STACKS=y
CONFIG_THREAD_STACK_INFO=y
CONFIG_SYS_HEAP_ARRAY_SIZE=1

CONFIG_SHELL_STACK_SIZE=3072
CONFIG_THREAD_NAME=y
```

## src/main.c
```c
/**
 * @file main.c
 * @brief Hello-world sample: runs a Lua script from both main and a Lua thread.
 */

#include <zephyr/kernel.h>

#include <lauxlib.h>
#include <lua.h>
#include <lualib.h>
#include <luaz_utils.h>

#include "sample01_lua_script.h"

/** @brief Setup hook for the hello_world Lua thread (loads the zephyr lib). */
int hello_world_lua_setup(lua_State *L)
{
	printk("Pre-lua vm setup for hello world lua by the user\n");

	LUA_REQUIRE(zephyr);
	return 0;
}

/** @brief Run the sample01 Lua script using the default Lua allocator. */
int main(int argc, char *argv[])
{
	lua_State *L = luaL_newstate();

	LUA_REQUIRE(zephyr);

	if (luaL_dostring(L, sample01_lua_script) != LUA_OK) {
		printk("Error: %s\n", lua_tostring(L, -1));
		lua_pop(L, 1);
	}

	lua_close(L);

	k_sleep(K_FOREVER);
	return 0;
}
```
