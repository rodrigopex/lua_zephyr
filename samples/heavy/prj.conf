## CMakeLists.txt
```
# SPDX-License-Identifier: Apache-2.0

cmake_minimum_required(VERSION 3.20.0)

set(ZEPHYR_EXTRA_MODULES "${CMAKE_CURRENT_SOURCE_DIR}/../../")

find_package(Zephyr REQUIRED HINTS $ENV{ZEPHYR_BASE})
project(heavy_sample)

include_directories(include/)

add_lua_thread("src/heavy.lua")

file(GLOB_RECURSE SRC ${CMAKE_SOURCE_DIR} "src/*.c")

target_sources(app PRIVATE ${SRC})
```

## sample.yaml
```
sample:
  name: Heavy
tests:
  sample.lua_zephyr.heavy:
    harness: console
    timeout: 300
    extra_configs:
      - platform:mps2/an385:CONFIG_QEMU_ICOUNT=y
      - platform:qemu_x86:CONFIG_QEMU_ICOUNT=y
      - CONFIG_SHELL=n
    harness_config:
      type: multi_line
      ordered: false
      regex:
        - "Heavy load sample finished"
        - "heap:\\s+\\d{4,5}\\s+\\d+\\s+\\d+\\s+\\d+%"
        - "stack:\\s+\\d+\\s+\\d+\\s+\\d+\\s+\\d+%"
    tags: lua_zephyr
    integration_platforms:
      - qemu_x86
      - mps2/an385
```

## prj.conf
```kconfig
CONFIG_LUA=y

CONFIG_BOOT_BANNER=n
CONFIG_QEMU_ICOUNT=n
CONFIG_LOG=y

CONFIG_SHELL=y
# CONFIG_THREAD_STATISTICS=y

CONFIG_ASSERT=y
CONFIG_MAIN_STACK_SIZE=2048
CONFIG_LUA_THREAD_STACK_SIZE=4096


CONFIG_SYS_HEAP_RUNTIME_STATS=y
CONFIG_SYS_HEAP_ARRAY_SIZE=1
```

## src/main.c
```c
/**
 * @file main.c
 * @brief Heavy sample: Lua thread with the string library enabled.
 */

#include <zephyr/kernel.h>

#include <lauxlib.h>
#include <lualib.h>
#include <luaz_utils.h>

/** @brief Setup hook for the heavy Lua thread (loads string + zephyr libs). */
int heavy_lua_setup(lua_State *L)
{
	LUA_REQUIRE(string);
	LUA_REQUIRE(zephyr);
	return 0;
}
```
