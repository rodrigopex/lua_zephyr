## CMakeLists.txt
```
# SPDX-License-Identifier: Apache-2.0

cmake_minimum_required(VERSION 3.20.0)

set(ZEPHYR_EXTRA_MODULES "${CMAKE_CURRENT_SOURCE_DIR}/../../")

find_package(Zephyr REQUIRED HINTS $ENV{ZEPHYR_BASE})
project(littlefs_sample)

include_directories(include/)

# Embed Lua scripts as C strings for bootstrap (written to FS at boot)
add_lua_file("src/hello_fs.lua")
add_lua_file("src/greet.lua")

# FS-backed thread: loads hello_fs.lua from LittleFS at runtime
add_lua_fs_thread("/lfs/hello_fs.lua")

file(GLOB_RECURSE SRC ${CMAKE_SOURCE_DIR} "src/*.c")

target_sources(app PRIVATE ${SRC})
```

## sample.yaml
```
sample:
  name: LittleFS Lua Sample
tests:
  sample.lua_zephyr.littlefs:
    harness: console
    extra_configs:
      - CONFIG_QEMU_ICOUNT=y
      - CONFIG_SHELL=n
      - CONFIG_LUA_FS_SHELL=n
      - CONFIG_LOG_MODE_MINIMAL=y
    harness_config:
      type: multi_line
      ordered: true
      regex:
        - "Bootstrap: writing scripts to LittleFS"
        - "Bootstrap: done"
        - "Hello from LittleFS!"
        - "Greetings from greet.lua!"
        - "dofile returned successfully"
        - "Lua Language Data:"
        - "language\\s+: Lua"
        - "file: greet.lua \\(\\d+ bytes\\)"
        - "file: hello_fs.lua \\(\\d+ bytes\\)"
        - "file: info.lua \\(\\d+ bytes\\)"
        - "heap:\\s+32768\\s+\\d+\\s+\\d+\\s+\\d+%"
        - "stack:\\s+\\d+\\s+\\d+\\s+\\d+\\s+\\d+%"
    tags: lua_zephyr
    integration_platforms:
      - qemu_x86
      - mps2/an385
```

## prj.conf
```kconfig
CONFIG_LUA=y
CONFIG_LUA_FS=y
CONFIG_LUA_FS_SHELL=y
CONFIG_LUA_LIB_BASE=y
CONFIG_LUA_LIB_STRING=y
CONFIG_LUA_PRECOMPILE=y
CONFIG_HELLO_FS_LUA_THREAD_STACK_SIZE=4096

CONFIG_BOOT_BANNER=n
CONFIG_QEMU_ICOUNT=n
CONFIG_LOG=y
CONFIG_LOG_MODE_MINIMAL=y
CONFIG_LUA_ZEPHYR_LOG_LEVEL_DBG=y

CONFIG_ASSERT=y
CONFIG_MAIN_STACK_SIZE=4096

CONFIG_FLASH=y
CONFIG_FLASH_MAP=y
CONFIG_FILE_SYSTEM=y
CONFIG_FILE_SYSTEM_LITTLEFS=y
CONFIG_FILE_SYSTEM_MKFS=y


CONFIG_SYS_HEAP_RUNTIME_STATS=y
CONFIG_INIT_STACKS=y
CONFIG_THREAD_STACK_INFO=y
CONFIG_SYS_HEAP_ARRAY_SIZE=1

CONFIG_SHELL_STACK_SIZE=3072
```

## src/main.c
```c
/**
 * @file main.c
 * @brief LittleFS sample: mount filesystem and bootstrap Lua scripts.
 *
 * Mounts a LittleFS partition (auto-formatting on first boot), then writes
 * the embedded Lua scripts to the filesystem so the FS-backed Lua thread
 * can load them at runtime.
 */

#include <zephyr/kernel.h>
#include <zephyr/fs/fs.h>
#include <zephyr/fs/littlefs.h>
#include <zephyr/storage/flash_map.h>
#include <zephyr/logging/log.h>
#include <lua_zephyr/luaz_fs.h>

#include "hello_fs_lua_script.h"
#include "greet_lua_script.h"

LOG_MODULE_REGISTER(littlefs_sample);

FS_LITTLEFS_DECLARE_DEFAULT_CONFIG(storage);

static struct fs_mount_t lua_lfs_mount = {
	.type = FS_LITTLEFS,
	.fs_data = &storage,
	.storage_dev = (void *)FIXED_PARTITION_ID(storage_partition),
	.mnt_point = CONFIG_LUA_FS_MOUNT_POINT,
};

/** @brief Mount LittleFS, auto-format on failure. */
static int mount_fs(void)
{
	int rc = fs_mount(&lua_lfs_mount);

	if (rc < 0) {
		LOG_WRN("fs_mount failed: %d, formatting...", rc);
		rc = fs_mkfs(FS_LITTLEFS, (uintptr_t)FIXED_PARTITION_ID(storage_partition), NULL,
			     0);
		if (rc < 0) {
			LOG_ERR("fs_mkfs failed: %d", rc);
			return rc;
		}
		rc = fs_mount(&lua_lfs_mount);
		if (rc < 0) {
			LOG_ERR("fs_mount after format failed: %d", rc);
			return rc;
		}
	}

	LOG_INF("LittleFS mounted at %s", CONFIG_LUA_FS_MOUNT_POINT);
	return 0;
}

int main(void)
{
	int rc = mount_fs();

	if (rc < 0) {
		printk("Failed to mount filesystem: %d\n", rc);
		return rc;
	}

	printk("Bootstrap: writing scripts to LittleFS\n");

	lua_fs_write_file("/lfs/hello_fs.lua", hello_fs_lua_script, 0);
	lua_fs_write_file("/lfs/greet.lua", greet_lua_script, 0);

	printk("Bootstrap: done\n");

	k_sleep(K_FOREVER);
	return 0;
}
```

## src/hello_fs_setup.c
```c
/**
 * @file hello_fs_setup.c
 * @brief Setup hook for the hello_fs LittleFS Lua thread.
 *
 * Loads the zephyr and fs libraries into the Lua state before the
 * FS-backed script executes.
 */

#include <lauxlib.h>
#include <lualib.h>
#include <lua_zephyr/utils.h>
#include <lua_zephyr/lua_fs.h>

/** @brief Setup hook: load zephyr + fs libraries for the FS-backed thread. */
int lfs_hello_fs_lua_lua_setup(lua_State *L)
{
	LUA_REQUIRE(zephyr);
	LUA_REQUIRE(base);
	LUA_REQUIRE(fs);
	return 0;
}
```
