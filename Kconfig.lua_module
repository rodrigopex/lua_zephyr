## Kconfig.lua_module
```kconfig
menu "Lua Zephyr"

config LUA
    bool "Lua support"
    select ZBUS
    select ZBUS_MSG_SUBSCRIBER
    help
      Enable Lua support. This is required for the Lua scripting engine.
      If you enable this option, you will be able to use Lua scripts and
      spawn Lua threads.

config LUA_REPL
    bool "Lua REPL support"
    depends on LUA
    select SHELL
    default n
    help
      Enable the Lua REPL (Read-Eval-Print Loop) support. This allows you to
      interactively run Lua commands via Zephyr's shell.

config LUA_REPL_LINE_SIZE
    int "Lua REPL line size"
    depends on LUA_REPL
    default 256
    help
      The maximum size of a line in the Lua REPL. This is the maximum number
      of characters that can be entered in a single line in the Lua REPL.

config LUA_THREAD_STACK_SIZE
    int "Lua thread stack size"
    depends on LUA
    default 2048
    help
      The stack size for Lua threads automatically created by Lua Zephyr.

config LUA_THREAD_HEAP_SIZE
  int "Lua thread heap size"
  depends on LUA
  default 32768
  help
    The heap size for Lua threads automatically created by Lua Zephyr.
    This is the size of the memory pool used by Lua for its internal
    memory management.

config LUA_THREAD_PRIORITY
  int "Lua thread priority"
  depends on LUA
  default 7
  help
    The priority of Lua threads automatically created by Lua Zephyr.
    Note that this is effectively the priority of the Lua thread and
    all will be created with this priority.

config LUA_LIBS_ALL
    bool "Preload all Lua standard libraries"
    depends on LUA
    default y
    help
      Preload all standard Lua libraries (string, table, math, coroutine,
      utf8, debug) and zbus into the Lua state. Disable to select
      individual libraries and reduce flash usage.

config LUA_LIB_STRING
    bool "Lua string library"
    depends on LUA
    default y if LUA_LIBS_ALL
    help
      Preload the Lua string library (string.format, string.sub, etc.).

config LUA_LIB_TABLE
    bool "Lua table library"
    depends on LUA
    default y if LUA_LIBS_ALL
    help
      Preload the Lua table library (table.insert, table.sort, etc.).

config LUA_LIB_MATH
    bool "Lua math library"
    depends on LUA
    default y if LUA_LIBS_ALL
    help
      Preload the Lua math library (math.sin, math.floor, etc.).

config LUA_LIB_COROUTINE
    bool "Lua coroutine library"
    depends on LUA
    default y if LUA_LIBS_ALL
    help
      Preload the Lua coroutine library.

config LUA_LIB_UTF8
    bool "Lua utf8 library"
    depends on LUA
    default y if LUA_LIBS_ALL
    help
      Preload the Lua utf8 library.

config LUA_LIB_DEBUG
    bool "Lua debug library"
    depends on LUA
    default y if LUA_LIBS_ALL
    help
      Preload the Lua debug library.

config LUA_LIB_ZBUS
    bool "Lua zbus library"
    depends on LUA
    default y if LUA_LIBS_ALL
    help
      Include zbus bindings as zephyr.zbus subtable.

config LUA_PRECOMPILE
    bool "Pre-compile Lua scripts to bytecode at build time"
    depends on LUA
    help
      Compiles .lua scripts to stripped bytecode during the build using a
      host-built luac. Reduces target heap usage by skipping the parse phase.

config LUA_PRECOMPILE_ONLY
    bool "Exclude Lua parser from target build (bytecode only)"
    depends on LUA_PRECOMPILE
    depends on !LUA_REPL
    help
      Removes lparser.c, llex.c, and lcode.c from the target binary.
      Saves ~15-20KB flash. All scripts must be pre-compiled.

config LUA_EXTRA_OPTIMIZATIONS
    bool "Extra heap optimizations for bytecode-only builds [EXPERIMENTAL]"
    depends on LUA_PRECOMPILE_ONLY
    select EXPERIMENTAL
    help
      Reduce Lua internal data structure sizes for lower heap usage.
      Saves ~636 bytes per lua_newstate on 32-bit targets by reducing
      the string table initial size (128->64) and string cache (53x2->11x1).

config LUA_FS
    bool "Lua filesystem support"
    depends on LUA
    depends on FILE_SYSTEM
    help
      Enable filesystem support for Lua scripts. Provides fs.dofile,
      fs.loadfile, and fs.list to Lua scripts, and replaces the standard
      dofile/loadfile globals with FS-backed versions.
      The application is responsible for mounting the filesystem before
      Lua threads start.

config LUA_FS_MOUNT_POINT
    string "Lua FS mount point"
    depends on LUA_FS
    default "/lfs"
    help
      Mount point prefix used by the Lua fs library for relative paths.

config LUA_FS_MAX_FILE_SIZE
    int "Maximum Lua script file size (bytes)"
    depends on LUA_FS
    default 4096
    help
      Maximum size of a Lua script file that can be loaded from the filesystem.

config LUA_FS_SHELL
    bool "Lua filesystem shell commands"
    depends on LUA_FS
    select SHELL
    help
      Enable shell commands for managing Lua scripts on the filesystem:
      lua_fs list, cat, write, delete, run, stat.

module = LUA_ZEPHYR
module-str = lua_zephyr
source "subsys/logging/Kconfig.template.log_config"
endmenu

choice LIBC_IMPLEMENTATION
    default NEWLIB_LIBC if LUA
endchoice

config COMMON_LIBC_REMOVE
    default n if LUA
```

## lua_module/Kconfig.lua_module
```kconfig
menu "Lua support"
config LUA
    bool "Lua support"
    default y
    help
      Enable Lua support. This is required for the Lua scripting engine.
      If you enable this option, you will be able to use Lua scripts in your
      configuration.
endmenu
```

## lua_zephyr/Kconfig.lua_module
```kconfig
menu "Lua Zephyr"

config LUA
    bool "Lua support"
    help
      Enable Lua support. This is required for the Lua scripting engine.
      If you enable this option, you will be able to use Lua scripts and
      spawn Lua threads.

config LUA_REPL
    bool "Lua REPL support"
    depends on LUA && SHELL
    default n
    help
      Enable the Lua REPL (Read-Eval-Print Loop) support. This allows you to
      interactively run Lua commands via Zephyr's shell.

config LUA_REPL_LINE_SIZE
    int "Lua REPL line size"
    depends on LUA_REPL
    default 256
    help
      The maximum size of a line in the Lua REPL. This is the maximum number
      of characters that can be entered in a single line in the Lua REPL.

config LUA_THREAD_STACK_SIZE
    int "Lua thread stack size"
    depends on LUA
    default 2048
    help
      The stack size for Lua threads automatically created by Lua Zephyr.

config LUA_THREAD_HEAP_SIZE
  int "Lua thread heap size"
  depends on LUA
  default 32768
  help
    The heap size for Lua threads automatically created by Lua Zephyr.
    This is the size of the memory pool used by Lua for its internal
    memory management. 

config LUA_THREAD_PRIORITY
  int "Lua thread priority"
  depends on LUA
  default 7
  help
    The priority of Lua threads automatically created by Lua Zephyr.
    Note that this is effectively the priority of the Lua thread and
    all will be created with this priority.

module = LUA_ZEPHYR
module-str = lua_zephyr
source "subsys/logging/Kconfig.template.log_config"
endmenu
```
